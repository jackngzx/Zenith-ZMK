## boards/shields/zenith/Kconfig.shield
```kconfig
# Copyright (c) 2025 The ZMK Contributors
# SPDX-License-Identifier: MIT


config SHIELD_ZENITH_DONGLE
    def_bool $(shields_list_contains,zenith_dongle)
    
config SHIELD_ZENITH_LEFT
    def_bool $(shields_list_contains,zenith_left)

config SHIELD_ZENITH_RIGHT
    def_bool $(shields_list_contains,zenith_right)

config SHIELD_ZENITH_LEFT_PERIPHERAL
    def_bool $(shields_list_contains,zenith_left_peripheral)

# This sets the role automatically based on the shield name
config ZMK_SPLIT_BLE_ROLE_CENTRAL
    default y if SHIELD_ZENITH_LEFT || SHIELD_ZENITH_DONGLE
    default n if SHIELD_ZENITH_LEFT_PERIPHERAL || SHIELD_ZENITH_RIGHT
```
