/*
 * Copyright (c) 2024 The ZMK Contributors
 *
 * SPDX-License-Identifier: MIT
 */
&pro_micro_i2c {
    status = "okay";

    oled: ssd1306@3c {
        compatible = "solomon,ssd1306fb";
        reg = <0x3c>;
        label = "DISPLAY";
        width = <128>;
        height = <32>; // Double check if yours is 32 or 64
        segment-remap;
        page-offset = <0>;
        display-offset = <0>;
        multiplex-ratio = <31>;
        segment-offset = <0>;
        com-invdir;
        com-sequential;
        prechargep = <0x22>;
    };
};
